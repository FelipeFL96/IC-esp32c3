## CMakeLists.txt
```
# SPDX-License-Identifier: GPL 3.0

cmake_minimum_required(VERSION 3.20.0)

find_package(Zephyr REQUIRED HINTS $ENV{ZEPHYR_BASE})
project(butantan)

FILE(GLOB app_sources src/*/*.c src/main.c)
target_sources(app PRIVATE ${app_sources})
```

## prj.conf
```kconfig
# General
CONFIG_PRINTK_BUFFER_SIZE=2048

# Wifi and network
CONFIG_WIFI=y
CONFIG_INIT_STACKS=y
CONFIG_NET_L2_WIFI_MGMT=y
CONFIG_NET_L2_ETHERNET=y

CONFIG_NETWORKING=y
CONFIG_NET_IPV4=y
CONFIG_NET_IPV6=y
CONFIG_NET_UDP=y
CONFIG_NET_TCP=y
CONFIG_NET_SOCKETS=y
CONFIG_NET_DHCPV4=y
CONFIG_NET_CONFIG_SETTINGS=y
CONFIG_NET_CONFIG_INIT_TIMEOUT=1
CONFIG_NET_TX_STACK_SIZE=2048
CONFIG_NET_RX_STACK_SIZE=2048
CONFIG_NET_PKT_RX_COUNT=10
CONFIG_NET_PKT_TX_COUNT=10
CONFIG_NET_BUF_RX_COUNT=20
CONFIG_NET_BUF_TX_COUNT=20
CONFIG_NET_MAX_CONTEXTS=10

CONFIG_DNS_RESOLVER=y
CONFIG_DNS_RESOLVER_AI_MAX_ENTRIES=10

CONFIG_HTTP_CLIENT=y

# i2c and aht sensor
CONFIG_I2C=y
CONFIG_SENSOR=y
```

## boards/esp32c3_supermini.overlay
```dts
&wifi {
    status = "okay";
};

&i2c0 {
    status = "okay";
    clock-frequency = <I2C_BITRATE_STANDARD>;
    pinctrl-0 = <&i2c0_default>;
    pinctrl-names = "default";
};
```

## src/main.c
```c
#include <stdio.h>
#include <stdlib.h>

#include <zephyr/kernel.h>
#include <zephyr/drivers/gpio.h>
#include <zephyr/sys/printk.h>

#include "wifi/http.h"
#include "wifi/ping.h"
#include "wifi/wifi.h"
#include "i2c_aht/aht.h"

#define SSID "Nayce"
#define PSK "22062012"

#define SERVER_IP "192.168.0.180"
#define SERVER_PORT 8000

#define SLEEP_TIME_MS 500
#define LED0_NODE DT_ALIAS(led0)

static const struct gpio_dt_spec led = GPIO_DT_SPEC_GET(LED0_NODE, gpios);

struct environment {
    int humidity;
    int temperature;
};

union env_data {
    struct environment env;
    int32_t raw[2];
};

bool network_connect(char *ssid, char *psk) {
    bool connected = false;
    int attempt = 0, max_attempts = 3;
    do {
        connected = wifi_connect(SSID, PSK);
        attempt++;
        printk("Conexão tentativa (%d/%d): %d\n", attempt, max_attempts, connected);
        k_msleep(200);
    } while (!connected && attempt < max_attempts);
    return connected;
}

int blink_led(int on_duration_ms) {
    int ret = gpio_pin_toggle_dt(&led);
    if (ret < 0) {
        printf("GPIO toggle failed\n");
        return ret;
    }
    k_msleep(on_duration_ms);
    ret = gpio_pin_toggle_dt(&led);
    if (ret < 0) {
        printf("GPIO toggle failed\n");
        return ret;
    }
    return ret;
}

int read_temperature_and_humidity(struct environment *env) {
    int ret = 0;
    uint32_t raw_hum = 0, raw_temp = 0;

    int attempts = 0, max_attempts = 3;
    do {
        ret = aht10_read_sensor(&raw_hum, &raw_temp);
        attempts++;
    } while (ret != 0 && attempts <= max_attempts);

    if (ret != 0) {
        return ret;
    }

    env->humidity = aht10_convert_humidity(raw_hum);
    env->temperature = aht10_convert_temperature(raw_temp);

    return ret;
}

void pritv(uint8_t *data, size_t size) {
    printf("(%p) [", data);
    for (int i = 0; i < size; i++) {
        printf(" %.2X", data[i]);
    }
    printf("]\n");
}

int main(void) {
    int ret;
    int sock = 0;
    int temperature, humidity;

    if (!gpio_is_ready_dt(&led)) {
        printf("GPIO is not ready\n");
        return 0;
    }

    ret = gpio_pin_configure_dt(&led, GPIO_OUTPUT_ACTIVE);
    if (ret < 0) {
        printf("GPIO pin configure failed\n");
        return 0;
    }

    ret = aht10_init();
    if (ret < 0) {
        printf("AHT10 intialization failed\n");
        return 0;
    }

    wifi_init();

    bool connected = network_connect(SSID, PSK);
    if (!connected) {
        printk("Connection failed!\n");
        return 1;
    }

    printk("Connected to Wi-Fi!\n");
    wifi_status();

    printk("\nConnecting to HTTP Server:\n");
	struct zsock_addrinfo *res;
	nslookup(SERVER_IP, &res);
	sock = connect_socket(&res, SERVER_PORT);

    http_post(sock, SERVER_IP, "/connection", NULL, 0);
    k_msleep(500);
    printk("\n");
    union env_data data;
    while (1) {
        ret = read_temperature_and_humidity(&(data.env));
        if (ret != 0) {
            printk(AHT10_NAME"Read failed. Resetting sensor\n");
            aht10_soft_reset();
            aht10_init();
            continue;
        }

        blink_led(500);
        k_msleep(100);
        blink_led(500);

        printf("Temperatura: %dºC, Umidade: %d%%\n\n", data.env.temperature, data.env.humidity);

        printf("Dados: %x %x\n", data.raw[0], data.raw[1]);

        //uint8_t payload[8];
        //memcpy(payload, data.raw, 8);

        char *payload[50];
        //payload[14] = 0;
        sprintf(payload, "t=%d&h=%d", data.env.temperature, data.env.humidity);
        int length = strlen(payload);
        printf("PAYLOAD: (%d)%s\n", length, payload);
        pritv(payload, 14);

        http_post(sock, SERVER_IP, "/environment", payload, length);
        k_msleep(900);
    }

	zsock_close(sock);

    return 0;
}
```
